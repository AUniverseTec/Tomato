## OS/kernel/linux_kernel_source_code/arch/arm/configs/tomato_defconfig
```kconfig
CONFIG_TOMATO=y
CONFIG_WIRELESS=y
CONFIG_AUDIO=y
CONFIG_POWER_MANAGEMENT=y

CONFIG_CMDLINE="console=ttyS0,115200 root=/dev/mmcblk0p2 rootwait"

CONFIG_MODULES=y
CONFIG_MODULE_UNLOAD=y
CONFIG_MODULE_FORCE_UNLOAD=y

CONFIG_NET=y
CONFIG_NET_WIRELESS=y
CONFIG_WIRELESS_EXT=y

CONFIG_SOUND=y
CONFIG_SOUND_ARM=y

CONFIG_POWER_SUPPLY=y
CONFIG_POWER_SUPPLY_BATTERY=y
```
